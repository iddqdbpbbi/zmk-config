#include "qdkbd.dtsi"

&default_transform { // The matrix transform for this board is 6 columns over because the left half is 6 columns wide according to the matrix.
    col-offset = <5>;
};

&kscan0 {
    row-gpios
        = <&gpio0 31 GPIO_ACTIVE_HIGH>
        , <&gpio0 29 GPIO_ACTIVE_HIGH>
        , <&gpio1 13 GPIO_ACTIVE_HIGH>
        , <&gpio1 6 GPIO_ACTIVE_HIGH> 
        ;
    
    col-gpios
        = <&gpio0 9 (GPIO_ACTIVE_HIGH | GPIO_PULL_DOWN)> 
        , <&gpio1 10 (GPIO_ACTIVE_HIGH | GPIO_PULL_DOWN)> 
        , <&gpio1 11 (GPIO_ACTIVE_HIGH | GPIO_PULL_DOWN)> 
        , <&gpio0 29 (GPIO_ACTIVE_HIGH | GPIO_PULL_DOWN)> 
        , <&gpio0 2 (GPIO_ACTIVE_HIGH | GPIO_PULL_DOWN)> 
        ;
};
