## boards/shields/qdkbd/Kconfig.defconfig
```kconfig
if SHIELD_QDKBD_LEFT

config ZMK_KEYBOARD_NAME
    default "qdkbd"

config ZMK_SPLIT_ROLE_CENTRAL
    default y

endif

if SHIELD_QDKBD_LEFT || SHIELD_QDKBD_RIGHT

config ZMK_SPLIT
    default y

endif
```

## boards/shields/qdkbd/Kconfig.shield
```kconfig
config SHIELD_QDKBD_LEFT
    def_bool $(shields_list_contains,qdkbd_left)

config SHIELD_QDKBD_RIGHT
    def_bool $(shields_list_contains,qdkbd_right)
```
